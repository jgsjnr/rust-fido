## crates/aegis-fido-firmware/sdkconfig.defaults
```kconfig
# Common ESP-IDF Configuration Defaults
CONFIG_ESP_MAIN_TASK_STACK_SIZE=32768
CONFIG_FREERTOS_HZ=1000
CONFIG_ESP_SYSTEM_EVENT_TASK_STACK_SIZE=4096
```
